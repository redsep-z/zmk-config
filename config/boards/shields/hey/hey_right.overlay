/*
 * Copyright (c) 2021 The ZMK Contributers
 *
 * SPDX-License-Identifier: MIT
 */

#include "hey.dtsi"

&default_transform {
  row_offset = <4>;
};

/ {
    kscan0: kscan {
        compatible = "zmk,kscan-gpio-matrix";
        label = "KSCAN";
        diode-direction = "col2row";

        col-gpios
        = <&pro_micro_a 2 GPIO_ACTIVE_HIGH>
        , <&pro_micro_a 1 GPIO_ACTIVE_HIGH>
        , <&pro_micro_a 0 GPIO_ACTIVE_HIGH>
        , <&pro_micro_d 15 GPIO_ACTIVE_HIGH>
        , <&pro_micro_d 14 GPIO_ACTIVE_HIGH>
        , <&pro_micro_d 16 GPIO_ACTIVE_HIGH>
        , <&pro_micro_d 10 GPIO_ACTIVE_HIGH>
        ;

        row-gpios
        = <&pro_micro_a 3 (GPIO_ACTIVE_HIGH | GPIO_PULL_DOWN)>
        , <&pro_micro_d 6 (GPIO_ACTIVE_HIGH | GPIO_PULL_DOWN)>
        , <&pro_micro_d 7 (GPIO_ACTIVE_HIGH | GPIO_PULL_DOWN)>
        , <&pro_micro_d 8 (GPIO_ACTIVE_HIGH | GPIO_PULL_DOWN)>
        ;
    };
};
