## config/boards/shields/hey/Kconfig.defconfig
```kconfig
if SHIELD_hey_LEFT

config ZMK_KEYBOARD_NAME
	default "hey Left"

config ZMK_SPLIT_BLE_ROLE_CENTRAL
	default y

endif

if SHIELD_hey_RIGHT

config ZMK_KEYBOARD_NAME
	default "hey Right"

endif

if SHIELD_hey_LEFT || SHIELD_hey_RIGHT

config ZMK_SPLIT
	default y

endif
```

## config/boards/shields/hey/Kconfig.shield
```kconfig
# Copyright (c) 2021 The ZMK Contributers
# SPDX-License-Identifier: MIT

config SHIELD_hey_LEFT
	def_bool $(shields_list_contains,hey_left)

config SHIELD_hey_RIGHT
	def_bool $(shields_list_contains,hey_right)
```
